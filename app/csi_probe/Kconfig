## app/csi_probe/Kconfig
```kconfig
#
# ESP32-P4X MIPI-CSI staged camera probe.
#

config LVX_USE_DEMO_CONTEST2026_031_CSI_PROBE
	bool "ESP32-P4X SC2336 camera probe"
	depends on ARCH_BOARD_ESP32P4_FUNCTION_EV_BOARD
	select ESPRESSIF_I2C0
	select I2C_RESET
	select ESPRESSIF_MIPI_CSI
	select ESPRESSIF_SPIRAM
	select ESPRESSIF_SPIRAM_USER_HEAP
	select ESP32P4_FUNCTION_EV_BOARD_CAMERA
	select ESP32P4_FUNCTION_EV_BOARD_CAMERA_SC2336
	default n
	---help---
		Build csi_probe, the staged camera validation program for the P4X
		Function EV Board.  "csi_probe sensor" validates the SC2336 product
		ID over SCCB/I2C0.  "csi_probe raw [1-10]" configures the P2
		1024x600 RAW8 sensor profile, collects bounded CSI/DMA frames in
		PSRAM, and reports CRC and CSI/DMA error diagnostics.  It does not
		register /dev/video0 or enable ISP processing.
```

## app/graphics_probe/Kconfig
```kconfig
config LVX_USE_DEMO_CONTEST2026_031_GRAPHICS_PROBE
	bool "ESP32-P4X DMA2D/PPA memory probe"
	depends on ARCH_BOARD_ESP32P4_FUNCTION_EV_BOARD && ESP32P4_DMA2D
	default n
	---help---
		Validate image copies and PPA operations without a display or camera.
		Supports explicit SRAM/PSRAM buffers and a memory matrix; the full
		matrix requires SPIRAM_USER_HEAP with a separate MM_KERNEL_HEAP.
```

## app/gt911_probe/Kconfig
```kconfig
#
# ESP32-P4X GT911 touchscreen probe.
#

config LVX_USE_DEMO_CONTEST2026_031_GT911_PROBE
	bool "ESP32-P4X GT911 touchscreen probe"
	depends on ARCH_BOARD_ESP32P4_FUNCTION_EV_BOARD
	select ESPRESSIF_I2C0
	select ESP32P4_FUNCTION_EV_BOARD_GT911
	default n
	---help---
		Build gt911_probe, a raw-event validation program for the P4X LCD
		adapter's Goodix GT911 capacitive touch controller.  The board
		registers /dev/input0 using I2C0 polling; this command reads and
		prints TOUCH_DOWN, TOUCH_MOVE and TOUCH_UP events before LVGL is
		connected to the device.
```

## app/smp_flash_test/Kconfig
```kconfig
config LVX_USE_DEMO_CONTEST2026_031_SMP_FLASH_TEST
	bool "ESP32-P4X SMP LittleFS concurrency test"
	depends on ESP32P4_SMP_SPIFLASH && ESPRESSIF_SPIFLASH
	default n
	---help---
		Build smp_flash_test, which exercises LittleFS on the SPI Flash
		MTD from both HP CPUs at the same time: per-CPU files, a shared
		file with per-CPU slots, and directory create/unlink churn.
```

## app/smp_psram_probe/Kconfig
```kconfig
config LVX_USE_DEMO_CONTEST2026_031_SMP_PSRAM_PROBE
	bool "ESP32-P4X SMP PSRAM probe"
	depends on ESP32P4_SMP_PSRAM && ESPRESSIF_SPIRAM_USER_HEAP
	default n
	---help---
		Build smp_psram, which allocates an external-memory buffer and
		checks concurrent writes and cross-core reads on both HP CPUs.
```

## board/esp32p4/esp32p4-function-ev-board/Kconfig
```kconfig
#
# For a description of the syntax of this configuration file,
# see the file kconfig-language.txt in the NuttX tools repository.
#

if ARCH_BOARD_CUSTOM

# configure.sh copies this board Kconfig to boards/dummy for an external
# board, while arch/risc-v/src/board points at the selected board common
# directory.  Import the common storage choices through that stable build
# path so ESPRESSIF_SPIFLASH_LITTLEFS survives olddefconfig/savedefconfig.
source "$BINDIR/arch/risc-v/src/board/Kconfig"

config ARCH_BOARD_ESP32P4_FUNCTION_EV_BOARD
	bool
	default y

config ESP32P4_FUNCTION_EV_BOARD_AUDIO_ES8311
	bool "Initialize ES8311 audio codec"
	select AUDIO
	select DRIVERS_AUDIO
	select AUDIO_ES8311
	select AUDIO_FORMAT_PCM
	select I2C
	select I2S
	select ESPRESSIF_I2C0
	select ESPRESSIF_I2S0
	default n
	help
		Initialize the ES8311 codec fitted to the P4X Function EV Board.
		The board uses I2C0 for codec control and I2S0 for PCM playback and
		capture, registering /dev/audio/pcm0 and /dev/audio/pcm_in0.  This
		option owns I2S0 and must not be combined with the generic I2S audio
		registration path.

config ESP32P4_FUNCTION_EV_BOARD_DSI_FRAMEBUFFER
	bool "Register the P4X MIPI-DSI framebuffer"
	depends on ESPRESSIF_SPIRAM_USER_HEAP
	depends on !LVX_USE_DEMO_CONTEST2026_031_DSI_PROBE
	select ESPRESSIF_MIPI_DSI
	select ESPRESSIF_MIPI_DSI_VIDEO
	select ESPRESSIF_MIPI_DSI_VIDEO_DMA
	select ESPRESSIF_MIPI_DSI_DPI_PANEL
	select VIDEO_FB
	select FB_UPDATE
	default n
	help
		Initialize the EK79007 1024x600 MIPI-DSI panel during board
		bring-up and expose its single RGB565 PSRAM scanout buffer as
		/dev/fb0.  FBIO_UPDATE performs the cache clean required before
		GDMA reads CPU-rendered pixels.

		This is mutually exclusive with the staged dsi_probe demo because
		both own the one P4 DSI Host and EK79007 panel lifecycle.

config ESP32P4_FUNCTION_EV_BOARD_GT911
	bool "Initialize GT911 touchscreen"
	depends on ESPRESSIF_I2C0 && ESPRESSIF_I2C0_MASTER_MODE
	select INPUT
	select INPUT_GT911
	default n
	help
		Register the P4X LCD adapter's Goodix GT911 capacitive touch
		controller as /dev/input0.  The reference board routes the shared
		I2C bus to GPIO8 (SCL) and GPIO7 (SDA).  The GT911 INT and RESET
		signals are not routed to the ESP32-P4 on the HMI subboard; they
		terminate on the LCD adapter's J6 header as INT_TP (pin 7) and
		RESET_TP (pin 8).  The default integration therefore uses a 20 ms
		polling worker.

if ESP32P4_FUNCTION_EV_BOARD_GT911

config ESP32P4_FUNCTION_EV_BOARD_GT911_MAX_POINTS
	int "GT911 touch points exposed to applications"
	range 1 5
	default 1
	---help---
		Number of simultaneous GT911 contacts exported through /dev/input0.
		Keep the P4X default at one point while using the upstream LVGL NuttX
		adapter: it reads fixed-size samples based on TSIOC_GETMAXPOINTS,
		whereas GT911 produces variable-size frames.  The Smart Home UI uses
		single-touch interactions only.  Raising this value requires a
		variable-length LVGL touchscreen adapter.

config ESP32P4_FUNCTION_EV_BOARD_GT911_IRQ
	bool "Use GT911 interrupt instead of polling"
	select ESPRESSIF_GPIO_IRQ
	default n
	---help---
		Read the GT911 from a GPIO interrupt instead of a 20 ms polling
		worker.  This requires hardware wiring that the board does not
		provide by default: run Dupont wires from the LCD adapter J6
		header INT_TP (pin 7) and RESET_TP (pin 8) to the GPIOs selected
		below, on the ESP32-P4 J1 header.  Interrupt mode also resets the
		controller through RESET_TP so the I2C address is latched
		deterministically to 0x5d.

		Leaving this disabled keeps the validated polling behaviour and
		needs no extra wiring.

config ESP32P4_FUNCTION_EV_BOARD_GT911_INT_GPIO
	int "GT911 INT GPIO"
	depends on ESP32P4_FUNCTION_EV_BOARD_GT911_IRQ
	range 0 54
	default 32
	---help---
		ESP32-P4 GPIO wired to INT_TP on the LCD adapter J6 header.
		GPIO32 is a plain J1 header pin with no on-board peripheral.

config ESP32P4_FUNCTION_EV_BOARD_GT911_RESET_GPIO
	int "GT911 RESET GPIO"
	depends on ESP32P4_FUNCTION_EV_BOARD_GT911_IRQ
	range 0 54
	default 33
	---help---
		ESP32-P4 GPIO wired to RESET_TP on the LCD adapter J6 header.
		GPIO33 is a plain J1 header pin with no on-board peripheral.  It
		must not be one of the LCD adapter's RST_LCD (GPIO27) or PWM
		(GPIO26) pins.

config ESP32P4_FUNCTION_EV_BOARD_GT911_IRQ_EDGE
	bool "Trigger on the INT falling edge instead of low level"
	depends on ESP32P4_FUNCTION_EV_BOARD_GT911_IRQ
	default n
	---help---
		By default the GT911 interrupt is level-low: the driver masks the
		interrupt in its ISR and unmasks it after acknowledging the frame,
		and the ESP GPIO block clears the pending bit while masked.  A
		falling-edge trigger can therefore lose an event that arrives in
		that window, because the edge may already be gone by the time the
		interrupt is re-armed.  Level-low re-asserts from the pin state and
		is the safer default.

		Enable this only if the measured INT pulse is too short for level
		detection, and verify with gt911_probe that no DOWN/UP pair is lost.

endif # ESP32P4_FUNCTION_EV_BOARD_GT911

config ESP32P4_FUNCTION_EV_BOARD_CAMERA
	bool "Enable P4X camera sensor control"
	select ESPRESSIF_I2C0
	default n
	help
		Enable board-private camera sensor control support.  The P2 staged
		implementation owns SCCB/I2C control and a fixed SC2336 RAW8 sensor
		profile for the csi_probe diagnostic.  It does not register /dev/video0
		or enable ISP processing.

config ESP32P4_FUNCTION_EV_BOARD_CAMERA_SC2336
	bool "Enable SC2336 staged camera control"
	depends on ESP32P4_FUNCTION_EV_BOARD_CAMERA
	default n
	---help---
		Enable the board-private SC2336 sensor control path.  It supports
		product-ID probing and the fixed P2 1024x600 RAW8 profile over the
		P4X camera module's SCCB/I2C0 connection.  CSI, DMA and diagnostics
		are initiated by the csi_probe application; this option does not
		register /dev/video0 or enable ISP processing.

config ESP32P4_FUNCTION_EV_BOARD_CAMERA_SC2336_VIDEO
	bool "Register SC2336 RGB565 capture device"
	depends on ESP32P4_FUNCTION_EV_BOARD_CAMERA_SC2336
	depends on !LVX_USE_DEMO_CONTEST2026_031_CSI_PROBE
	select I2C_RESET
	select ESPRESSIF_MIPI_CSI
	select ESPRESSIF_SPIRAM
	select ESPRESSIF_SPIRAM_USER_HEAP
	select DRIVERS_VIDEO
	select VIDEO_STREAM
	select ESPRESSIF_ISP
	select ESPRESSIF_MIPI_CSI_VIDEO
	default n
	help
		Register the P4X SC2336 camera as /dev/video0. The sensor sends
		RAW8 while the P4 ISP converts it to RGB565 for V4L2.

config ESP32P4_FUNCTION_EV_BOARD_ESP_HOSTED
	bool "Probe onboard ESP32-C6 through ESP-Hosted SDIO"
	select ESPRESSIF_HOSTED_TRANSPORT
	select ESPRESSIF_HOSTED_WLAN
	default n
	help
		Reset the ESP32-C6 fitted to the ESP32-P4X Function EV Board, route
		the ESP32-P4 SDMMC slot 1 pins during board bring-up.  The P4
		ESP-Hosted transport then runs its 400 kHz, one-bit control-plane
		probe, verifies C6 SDIO function 0 CCCR and exchanges the private
		initialization events, starts the C6 station service and registers
		its NuttX wlan0 data path.

		The board requires the documented external pull-ups on CMD and DAT0
		through DAT3.  The GPIO pull-ups configured by this option only keep
		the lines in a defined state during reset; they do not replace those
		external resistors.

if ESP32P4_FUNCTION_EV_BOARD_ESP_HOSTED

config ESP32P4_FUNCTION_EV_BOARD_ESP_HOSTED_STA_SSID
	string "ESP-Hosted station SSID"
	default ""
	help
		SSID used for the optional ESP32-C6 station connection request.  Keep
		this empty to initialize wlan0 without associating an access point.
		Do not save site-specific credentials in a tracked defconfig.

config ESP32P4_FUNCTION_EV_BOARD_ESP_HOSTED_STA_PASSWORD
	string "ESP-Hosted station password"
	default ""
	help
		Password used with ESP32P4_FUNCTION_EV_BOARD_ESP_HOSTED_STA_SSID.
		An empty password is permitted for an open access point.  Set this in
		the local build configuration; do not save it in a tracked defconfig.

endif # ESP32P4_FUNCTION_EV_BOARD_ESP_HOSTED

endif # ARCH_BOARD_CUSTOM
```

## board/esp32p4/esp32p4-function-ev-board/configs/smart_home_alarms/defconfig
```kconfig
#include "../smart_home/defconfig"
CONFIG_SMART_HOME_REMINDERS=y
CONFIG_SMART_HOME_REMINDER_RING=y
```

## board/esp32p4/esp32p4-function-ev-board/configs/smp_display/defconfig
```kconfig
#include "../smp_psram/defconfig"
CONFIG_BOARD_LATE_INITIALIZE=y
CONFIG_ESP32P4_FUNCTION_EV_BOARD_DSI_FRAMEBUFFER=y
CONFIG_EXAMPLES_FB=y
CONFIG_SCHED_LPWORK=y
```

## board/esp32p4/esp32p4-function-ev-board/configs/smp_psram/defconfig
```kconfig
#include "../smp/defconfig"
CONFIG_ESP32P4_SMP_PSRAM=y
CONFIG_ESPRESSIF_SPIRAM=y
CONFIG_ESPRESSIF_SPIRAM_BOOT_INIT=y
CONFIG_ESPRESSIF_SPIRAM_USER_HEAP=y
CONFIG_LVX_USE_DEMO_CONTEST2026_031_SMP_PSRAM_PROBE=y
```

## board/esp32p4/esp32p4-function-ev-board/configs/smp_touch/defconfig
```kconfig
#include "../smp_display/defconfig"
CONFIG_LVX_USE_DEMO_CONTEST2026_031_GT911_PROBE=y
```
