## packages/cAGENT/Kconfig
```kconfig
############################################################################
# packages/cAGENT/Kconfig
#
# cAGENT（vendored cAgentV2）NuttX 包配置。
#
# 容量项直接使用 AGENT_* 符号名：Kconfig 生成 CONFIG_AGENT_* 后，经
# nuttx/config.h 传入，include/agent/config.h 按三级默认（-D 宏 >
# CONFIG_AGENT_* > 内置默认）解析，无需 Makefile 桥接。
############################################################################

menuconfig CAGENT
	bool "cAGENT: vendored cAgentV2 agent core"
	default n
	help
	  Synchronous ReAct agent core vendored from the cAgentV2
	  repository (see V2_SNAPSHOT_COMMIT). Borrowed buffers, no
	  dynamic allocation in the core. Replaces the legacy cAGENT
	  implementation; applications must use the V2 APIs.

if CAGENT

config CAGENT_PROVIDER_OPENAI
	bool "OpenAI-compatible model provider"
	default y
	help
	  Non-streaming Chat Completions provider over the transport
	  adapter. Emits "max_completion_tokens" by default; the
	  application may request the legacy "max_tokens" field per
	  provider instance.

config CAGENT_SESSION_RAM
	bool "Bounded RAM Session Storage"
	default n

config CAGENT_PORT_OPENVELA_RUNTIME
	bool "OpenVela monotonic-clock runtime"
	default y

config CAGENT_PORT_OPENVELA_TRANSPORT
	bool "OpenVela webclient HTTP transport"
	depends on NETUTILS_WEBCLIENT
	default y

config CAGENT_PORT_OPENVELA_TLS
	bool "OpenVela mbedTLS backend for webclient TLS"
	depends on NETUTILS_WEBCLIENT
	select CRYPTO_MBEDTLS
	select DEV_RANDOM if ARCH_HAVE_RNG
	default n
	help
	  Blocking mbedTLS sessions exposed as webclient_tls_ops.
	  Certificate verification defaults to OPTIONAL (checked and
	  logged, not enforced); supply a PEM bundle and select
	  VERIFY_REQUIRED at runtime to enforce the chain.

comment "cAGENT V2 capacities (build-time, borrowed-buffer sizes)"

config AGENT_MAX_TOOLS
	int "Maximum registered tools"
	default 12
	range 0 64

config AGENT_MAX_SKILLS
	int "Maximum registered skills"
	default 8
	range 0 64

config AGENT_MAX_CONTEXTS
	int "Maximum registered context providers"
	default 8
	range 0 64

config AGENT_MAX_SESSIONS
	int "Maximum named sessions"
	default 4
	range 0 16

config AGENT_MAX_INPUT_BYTES
	int "Maximum single-turn user input bytes"
	default 1024

config AGENT_MAX_CONTEXT_BYTES
	int "Context projection budget bytes"
	default 4096

config AGENT_MAX_SCHEMA_BYTES
	int "Per-tool JSON schema budget bytes"
	default 2048

config AGENT_MAX_ARGUMENTS_BYTES
	int "Per-tool-call arguments budget bytes"
	default 1024

config AGENT_MAX_TOOL_OUTPUT_BYTES
	int "Per-tool output budget bytes"
	default 1024

config AGENT_MAX_MODEL_OUTPUT_BYTES
	int "Model final output budget bytes"
	default 2048

config AGENT_MAX_MODEL_TOOL_CALLS
	int "Maximum tool calls per model step"
	default 4
	range 1 16

config AGENT_MAX_PROJECTED_MESSAGES
	int "Maximum projected session messages"
	default 32

config AGENT_SESSION_EVENT_CAPACITY
	int "Session event capacity"
	default 96

config AGENT_SESSION_PAYLOAD_BYTES
	int "Session payload pool bytes"
	default 8192

config AGENT_SCRATCH_BYTES
	int "Per-turn scratch arena bytes"
	default 12288

config AGENT_CORE_WORKSPACE_BYTES
	int "Core caller-storage bytes"
	default 32768

config AGENT_MAX_NAME_BYTES
	int "Registered name budget bytes"
	default 64

config AGENT_MAX_DESCRIPTION_BYTES
	int "Registered description budget bytes"
	default 256

config AGENT_MAX_JSON_DEPTH
	int "Maximum JSON nesting depth"
	default 16
	range 1 32

endif # CAGENT
```
