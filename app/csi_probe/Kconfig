## demos/smart_home/Kconfig
```kconfig
config SMART_HOME_DEMO
    bool "Smart home demo"
    select CAGENT
    select NETUTILS_WEBCLIENT
    select CAGENT_SESSION_RAM
    select CAGENT_PROVIDER_OPENAI
    select CAGENT_PORT_OPENVELA_RUNTIME
    select CAGENT_PORT_OPENVELA_TRANSPORT
    select CAGENT_PORT_OPENVELA_TLS
    default n
    help
      Smart home cAGENT demo skeleton with separated agent, tool, skill,
      device and console UI modules.

if SMART_HOME_DEMO

config SMART_HOME_DEMO_DEBUG_LOG
    bool "Enable smart_home debug logging"
    default y
    help
      Print user input, agent replies, tool-call events and LVGL lifecycle
      steps to the console. Useful for debugging on QEMU; disable to reduce
      output in production.

config SMART_HOME_DEMO_STACKSIZE
    int "Smart home demo task stack size"
    default 32768

config SMART_HOME_DEMO_PRIORITY
    int "Smart home demo task priority"
    default 100

config SMART_HOME_MODEL_REQUEST_BUFFER_SIZE
    int "Model request buffer capacity"
    default 16384
    range 8192 65536

config SMART_HOME_MODEL_RESPONSE_BUFFER_SIZE
    int "Model response buffer capacity"
    default 16384
    range 1024 65536

config SMART_HOME_MODEL_DECODED_BUFFER_SIZE
    int "Model decoded text buffer capacity"
    default 8192
    range 2048 32768

config SMART_HOME_MODEL_JSON_TOKENS
    int "Model response JSON token capacity"
    default 512
    range 128 2048

config SMART_HOME_SESSION_HISTORY_TURNS
    int "Recent complete turns projected to model"
    default 3
    range 1 6

config SMART_HOME_SESSION_PAYLOAD_BYTES
    int "RAM session payload capacity"
    default 65536
    range 16384 262144

config SMART_HOME_USER_MEMORY
    bool "Persist explicit long-term user preferences"
    default n
    help
      Register user_memory (remember/list/forget). Save bounded preferences
      separately from conversations; inject a reference snapshot each turn.

if SMART_HOME_USER_MEMORY

config SMART_HOME_USER_MEMORY_MAX_ENTRIES
    int "Maximum saved preferences"
    default 16
    range 1 16

config SMART_HOME_USER_MEMORY_CONTEXT_BYTES
    int "Preference reference snapshot bytes"
    default 768
    range 512 2048

endif

config SMART_HOME_SESSION_PERSIST
    bool "Persist conversations and restore chat history"
    select CAGENT_SESSION_JSONL
    select CAGENT_FILE_STORE
    default n
    help
      Store completed turns in /data/smart_home/sessions. Restore chat
      history on startup; New conversation also removes the saved records.

if SMART_HOME_SESSION_PERSIST

config SMART_HOME_SESSION_RETAIN_TURNS
    int "Maximum saved complete turns"
    default 20
    range 4 40

config SMART_HOME_SESSION_FILE_BYTES
    int "Maximum session file bytes"
    default 1048576
    range 262144 2097152

config SMART_HOME_SESSION_LINE_BYTES
    int "Maximum encoded turn bytes"
    default 131072
    range 32768 524288

endif

config SMART_HOME_REMINDERS
    bool "Persistent countdown reminders and one-shot alarms"
    depends on NETUTILS_CJSON
    depends on SMART_HOME_DEMO_UI_LVGL
    default n
    help
      Persist up to eight reminders in /data/smart_home/reminders.json.
      Requires a valid wall clock (2024..2037); alarm dates use UTC+08:00.
      The application must be running. No RTC wake or recurring alarms.

config SMART_HOME_REMINDER_RING
    bool "Offline local tone for reminders"
    depends on SMART_HOME_REMINDERS
    depends on ESP32P4_FUNCTION_EV_BOARD_AUDIO_ES8311
    default y
    help
      Play a five-second PCM tone through the shared speech audio worker.
      Does not require TTS, network access or an API key.

config SMART_HOME_AUDIO_SMOKE
    bool "ES8311 audio smoke command"
    depends on ESP32P4_FUNCTION_EV_BOARD_AUDIO_ES8311
    default n
    help
      Build the audio_smoke NSH command for the P4X ES8311 bring-up.  The
      command plays a fixed 16 kHz PCM tone or records raw PCM from the
      board codec without starting LVGL, networking, ASR, or TTS.

if SMART_HOME_AUDIO_SMOKE

config SMART_HOME_AUDIO_SMOKE_STACKSIZE
    int "ES8311 audio smoke command stack size"
    default 8192
    range 4096 16384

endif

config SMART_HOME_VOICE_TTS
    bool "Agent reply voice announcement (TTS)"
    depends on ESP32P4_FUNCTION_EV_BOARD_AUDIO_ES8311
    depends on NETUTILS_CJSON
    default n
    help
      Announce agent replies through the ES8311 speaker.  Adds the shared
      PCM16 mono voice player, the cloud TTS synthesis client (OpenAI
      compatible /v1/audio/speech), a queued announcement service and the
      chat-screen auto-announce hook.  The announce switch is persisted in
      /data/smart_home/voice.json; API keys are read from secrets.json.

if SMART_HOME_VOICE_TTS

config SMART_HOME_TTS_AUDIO_MAX_BYTES
    int "Maximum TTS audio response buffer"
    default 1048576
    range 65536 2097152
    help
      Upper bound of the PSRAM buffer holding one synthesized WAV
      response.  For speech-style backends (binary WAV) 1 MiB is about
      32 s at 16 kHz PCM16 mono; for chat-style backends (MiMo) the
      response is JSON-wrapped base64 (~4/3 larger), so the effective
      audio cap is about 768 KiB.

config SMART_HOME_VOICE_TEXT_MAX
    int "Maximum announcement text length"
    default 512
    range 128 2048

config SMART_HOME_VOICE_WORKER_STACKSIZE
    int "Voice announcement worker stack size"
    default 32768
    range 16384 65536
    help
      The worker performs the mbedTLS synthesis request; the size follows
      the agent worker stack budget.

endif

config SMART_HOME_TTS_SMOKE
    bool "TTS pipeline smoke command"
    depends on SMART_HOME_VOICE_TTS
    default n
    help
      Build the tts_smoke NSH command for the voice announcement bring-up.
      It plays a raw PCM16 mono file through the same shared player as the
      announcement service (play subcommand) and synthesizes plus plays a
      short text once the TTS backend is configured (speak subcommand).  It
      deliberately starts no LVGL UI and touches no agent state.

if SMART_HOME_TTS_SMOKE

config SMART_HOME_TTS_SMOKE_STACKSIZE
    int "TTS smoke command stack size"
    default 32768
    range 16384 65536
    help
      The speak subcommand runs the full mbedTLS synthesis request on the
      command stack.  mbedTLS does not fit in the 8 KiB NSH default (the
      handshake overflows and hard-freezes the system before any error
      can print); this follows the agent chat worker budget.

endif

config SMART_HOME_VOICE_ASR
    bool "Agent voice input (ASR, MiMo-V2.5-ASR)"
    depends on ESP32P4_FUNCTION_EV_BOARD_AUDIO_ES8311
    depends on NETUTILS_CJSON
    default n
    help
      Add push-to-talk voice input to the chat screen.  A shared capture
      service owns /dev/audio/pcm_in0 (16 kHz PCM16 mono) and feeds both
      ASR sessions and (later) the KWS listener.  Recordings are
      recognized by the MiMo-V2.5-ASR cloud API (OpenAI-compatible chat
      completions with base64 WAV input_audio) and the transcript is
      auto-submitted to the agent.  The voice-input switch and language
      (zh/en/auto) are persisted in /data/smart_home/asr.json; the API
      key reuses model_api_keys.mimo from secrets.json.

if SMART_HOME_VOICE_ASR

config SMART_HOME_VOICE_CAPTURE_STACKSIZE
    int "Shared capture worker stack size"
    default 8192
    range 4096 16384
    help
      The capture worker only dispatches audio frames to the active
      consumer; heavy processing must happen in consumer threads.

config SMART_HOME_VOICE_ASR_WORKER_STACKSIZE
    int "ASR worker stack size"
    default 32768
    range 16384 65536
    help
      The worker performs the mbedTLS recognition request; the size
      follows the voice announcement worker budget.

config SMART_HOME_ASR_AUDIO_MAX_SECONDS
    int "Maximum ASR recording seconds"
    default 12
    range 2 30
    help
      Upper bound of one PTT recording.  The chat screen stops early on
      the second tap; 12 s is about 384 KiB PCM16 mono at 16 kHz.

config SMART_HOME_ASR_SMOKE
    bool "ASR pipeline smoke command"
    default n
    help
      Build the asr_smoke NSH command.  record captures via the shared
      capture service and reports the byte count; recognize additionally
      calls the MiMo ASR API and prints the transcript.  It starts no
      LVGL UI and touches no agent state.

if SMART_HOME_ASR_SMOKE

config SMART_HOME_ASR_SMOKE_STACKSIZE
    int "ASR smoke command stack size"
    default 32768
    range 16384 65536
    help
      The speak-equivalent recognize subcommand runs the mbedTLS request
      on the command stack.

endif

endif

config SMART_HOME_VAD
    bool "Energy-based VAD on the shared audio capture path"
    depends on ESP32P4_FUNCTION_EV_BOARD_AUDIO_ES8311
    default n
    help
      Add an integer-only voice activity detector to the shared capture
      service.  It runs on every captured frame before the registered
      consumer, so it keeps working while ASR and KWS swap the consumer
      slot.  Once speech has been seen, a sustained silence ends the
      recording early, which turns push-to-talk into "speak and stop".

      The detector uses a 20 ms frame with a 10 ms hop, a slow/fast
      adaptive noise floor, a relative threshold and an absolute energy
      floor, then a start/hangover state machine.  No floating point and
      no libm calls are used, which matters on the current P4 build
      (single core, soft float).

if SMART_HOME_VAD

config SMART_HOME_VAD_RATIO_PCT
    int "Speech threshold relative to the noise floor (percent)"
    default 400
    range 150 2000
    help
      A frame counts as speech when its energy exceeds the tracked noise
      floor by this percentage.  400 means +6 dB.  Raise it in noisy
      rooms, lower it for far-field talkers.

config SMART_HOME_VAD_MIN_ENERGY
    int "Absolute frame energy floor"
    default 400
    range 0 100000
    help
      Frames below this energy are never speech, which keeps the
      detector quiet on digital silence where the noise floor can
      collapse towards zero.  Energy is sum(x^2) >> 12 over a 20 ms
      frame at 16 kHz; 400 corresponds to an RMS of roughly 90 LSB.

config SMART_HOME_VAD_INIT_FRAMES
    int "Noise floor initialisation frames"
    default 10
    range 1 200
    help
      During the first N frames the noise floor follows the minimum
      observed energy, so starting a recording on speech does not bias
      the floor upwards.

config SMART_HOME_VAD_START_FRAMES
    int "Consecutive speech frames required to start"
    default 3
    range 1 50
    help
      Each frame advances 10 ms, so the default needs 30 ms of speech.

config SMART_HOME_VAD_END_FRAMES
    int "Consecutive silence frames required to end"
    default 30
    range 1 300
    help
      Hangover before the detector reports the end of speech.  The
      default is 300 ms, which keeps short pauses between words from
      splitting an utterance.

config SMART_HOME_VAD_AUTOSTOP_SILENCE_MS
    int "Recording auto-stop silence in ms"
    default 500
    range 0 5000
    help
      After speech has been detected, the ASR recording ends when this
      much additional silence follows the detector's end-of-speech
      event.  0 disables the early stop and keeps the fixed duration.

endif

config SMART_HOME_KWS
    bool "Resident KWS wake-word service (wake_large int8)"
    depends on ESP32P4_FUNCTION_EV_BOARD_AUDIO_ES8311
    depends on TFLITEMICRO
    default n
    help
      Offline always-on wake-word detection with the wake_large int8
      ds_cnn_s3 model (37,408 bytes).  The ESP32-P4 has no ESP-NN
      backend, so TFLite Micro reference kernels are used.  A resident
      service consumes the shared capture service, keeps a 2.5 s PCM
      ring, computes the 124x40x3 feature front-end and reports wake
      hits through a callback with threshold voting and cooldown.
      NOTE: the feature front-end constants are provisional until they
      are verified value-by-value against the training pipeline; treat
      on-device wake rates as unvalidated until then.

if SMART_HOME_KWS

config SMART_HOME_KWS_ARENA_SIZE
    int "KWS tensor arena size"
    default 393216
    range 65536 3145728
    help
      PSRAM buffer reserved for TFLite Micro tensors of wake_large.
      The service reports the actual arena use after AllocateTensors.

      The model needs about 199 KB on the target (conv/depthwise output
      tensors alone total ~516 KB across 4 conv + 3 dw nodes when the
      arena is shared; the reference path allocates ~199 KB). The old
      196608 default was below the real requirement, so the resident
      service failed at AllocateTensors with -ENOMEM. 393216 leaves
      headroom for the ESP-NN path, which additionally requests a
      filter copy and scratch per node.

config SMART_HOME_KWS_WORKER_STACKSIZE
    int "KWS inference worker stack size"
    default 32768
    range 8192 131072
    help
      The worker runs the C++ TFLite Micro interpreter plus the feature
      front-end on its own stack. 12 KB was too tight once ESP-NN and the
      full front-end are enabled; 32 KB leaves room without depending on
      unmeasured luck. Keep this independent from the smoke command stack.

config SMART_HOME_KWS_INTERVAL_MS
    int "KWS inference interval in ms"
    default 500
    range 100 2000
    help
      How often the 2.5 s sliding window is re-evaluated.  Start
      conservative; tighten only after kws_smoke reports the real
      reference-kernel Invoke latency on the target.

config SMART_HOME_KWS_THRESHOLD
    int "KWS wake threshold in per-mille"
    default 750
    range 1 1000
    help
      Starting point from the offline threshold sweep (0.75); real-room
      false-wake tuning must be done on the device.

config SMART_HOME_KWS_COOLDOWN_MS
    int "KWS wake cooldown in ms"
    default 3000
    range 500 30000

endif

config SMART_HOME_KWS_SMOKE
    bool "KWS model smoke/benchmark command"
    depends on TFLITEMICRO
    default n
    help
      Build the kws_smoke NSH command.  It validates the TFLite model,
      operator registration, tensor contract and arena use, then
      benchmarks Invoke() with a deterministic int8 feature buffer.
      It opens no audio device and runs no recognition.

if SMART_HOME_KWS_SMOKE

config SMART_HOME_KWS_SMOKE_ARENA_SIZE
    int "KWS smoke tensor arena size"
    default 393216
    range 65536 3145728

config SMART_HOME_KWS_SMOKE_STACKSIZE
    int "KWS smoke command stack size"
    default 12288
    range 8192 32768

endif

config SMART_HOME_DEMO_OFFLINE_UI
    bool "Offline regular LVGL UI bring-up"
    depends on SMART_HOME_DEMO_UI_LVGL
    depends on !SMART_HOME_DEMO_STATIC_LVGL_HOME
    default n
    help
      Start the regular Smart Home agent and LVGL UI without initializing a
      network transport or compiling the default mbedTLS HTTP callback. This
      profile is intended for board display and touchscreen bring-up. Local
      device panels and settings remain available; cloud chat reports the
      model as unavailable until a network-capable profile is selected.

config SMART_HOME_AHT30_TOOL
    bool "Enable Box3 AHT30 indoor environment tool"
    depends on ARCH_CHIP_ESP32S3 && ESP32S3_BOX3_SENSOR
    default y
    help
      Register get_indoor_environment as a local, read-only tool. It samples
      the ESP32-S3-BOX-3-SENSOR-01 AHT30 at /dev/aht0 for each call. The tool
      is intentionally unavailable on non-ESP32-S3 targets and does not
      replace the demo's simulated environment state.

config SMART_HOME_MAX_BACKENDS
    int "Maximum LLM backend presets in backends.json"
    default 8
    help
      Upper bound for the backends array in /data/smart_home/backends.json.
      backends.json is loaded by smart_home_config_store; exceeding this
      limit causes the file to be rejected and built-in presets to be used.

config SMART_HOME_MODEL_SECRETS_PATH
    string "Model API key secrets JSON path"
    default "/data/smart_home/secrets.json"
    help
      Version 1 secrets JSON containing model_api_keys, indexed by backend ID.
      This file is read only: absent, malformed, or empty keys leave only the
      affected cloud model unavailable; smart_home never falls back to a
      compiled credential or writes a replacement file.

config SMART_HOME_MODEL_SECRETS_MAX_FILE_SIZE
    int "Maximum model secrets JSON size"
    default 4096
    range 512 16384
    help
      Bounded read limit for the dedicated model credential loader. Keep this
      small because the file contains credentials and only model_api_keys is
      needed by this consumer.

config SMART_HOME_APP_BRIDGE
    bool "Mobile app HTTP/WebSocket bridge"
    default n
    select CAGENT_ADDONS
    select CAGENT_ADDONS_NODE
    help
      Expose the smart-home snapshot and controls to a trusted mobile app on
      the local network. The bridge requires app_bridge.shared_token in the
      configured secrets JSON and never compiles credentials into firmware.

if SMART_HOME_APP_BRIDGE

config SMART_HOME_APP_BRIDGE_SECRETS_PATH
    string "Mobile app bridge secrets JSON path"
    default "/data/smart_home/secrets.json"

config SMART_HOME_APP_BRIDGE_PORT
    int "Mobile app bridge HTTP/WebSocket port"
    default 8080
    range 1 65535

config SMART_HOME_APP_BRIDGE_STACKSIZE
    int "Mobile app bridge worker stack size"
    default 8192
    range 4096 32768

config SMART_HOME_APP_BRIDGE_WORKER
    bool "Enable mobile app bridge HTTP worker"
    default y
    help
      Create the HTTP/WebSocket accept worker for the mobile app bridge.

if SMART_HOME_APP_BRIDGE_WORKER

config SMART_HOME_APP_BRIDGE_WORKER_ACCEPT
    bool "Enable mobile app bridge accept loop"
    default y
    help
      Let the bridge worker accept HTTP/WebSocket connections.

endif

config SMART_HOME_APP_BRIDGE_CHAT
    bool "Enable mobile app chat service"
    default n
    help
      Create the background worker that executes cloud AI requests received
      from the mobile app. It is disabled by default temporarily while
      isolating the bridge worker's runtime footprint.

config SMART_HOME_APP_BRIDGE_RUN_STACKSIZE
    int "Mobile app bridge AI run worker stack size"
    default 65536
    range 16384 98304
    help
      Stack for the worker that runs cAGENT, TLS and the cloud LLM request
      on behalf of a mobile chat message. This is intentionally separate
      from the small HTTP accept worker; mbedTLS does not fit in its stack.

endif

config SMART_HOME_NODE_GATEWAY
    bool "OpenClaw Node gateway"
    default n
    select CAGENT_ADDONS
    select CAGENT_ADDONS_NODE
    select CAGENT_ADDONS_NODE_GATEWAY
    help
      Make smart_home the trusted OpenClaw Node gateway. Connected Node
      commands are dynamically registered into the local cAGENT instance.
      The shared token is read from SMART_HOME_NODE_GATEWAY_SECRETS_PATH;
      it is never compiled into the firmware.

if SMART_HOME_NODE_GATEWAY

config SMART_HOME_NODE_GATEWAY_SECRETS_PATH
    string "Node gateway secrets JSON path"
    default "/data/smart_home/secrets.json"
    help
      Version 1 secrets JSON containing node_gateway.shared_token. The
      gateway refuses to listen if this file is absent, malformed, or has an
      empty token. Unless SMART_HOME_NODE_GATEWAY_REQUIRED is selected, the
      rest of smart_home continues to run in this case.

config SMART_HOME_NODE_GATEWAY_REQUIRED
    bool "Require Node gateway during smart_home startup"
    default n
    help
      Fail smart_home startup if the Node gateway cannot read credentials,
      allocate its worker, or listen on its configured port. Leave disabled
      for normal product and UI use: the gateway becomes unavailable but
      local tools and AI chat remain available. Enable for CI or dedicated
      Node bring-up to fail fast on an invalid environment.

config SMART_HOME_NODE_GATEWAY_BIND_HOST
    string "Node gateway bind address"
    default "0.0.0.0"

config SMART_HOME_NODE_GATEWAY_PORT
    int "Node gateway WebSocket port"
    default 18790
    range 1 65535

config SMART_HOME_NODE_GATEWAY_WORKER_STACKSIZE
    int "Node gateway catalog worker stack size"
    default 8192
    range 4096 32768
    help
      Stack for the smart_home worker that serializes remote-tool registry
      mutations with agent runs. WebSocket transport threads are configured
      separately by cAGENT addons.

endif

config SMART_HOME_MCP_BRIDGE
    bool "Standard MCP Streamable HTTP client"
    default n
    select CAGENT_ADDONS
    select CAGENT_ADDONS_MCP
    help
      Connect smart_home directly to one configured standard MCP Server.
      Non-sensitive endpoint/tool config comes from
      SMART_HOME_MCP_BRIDGE_CONFIG_PATH; sensitive header values (e.g. API
      keys) are referenced as ${VAR} and resolved from
      SMART_HOME_MCP_BRIDGE_SECRETS_PATH.

if SMART_HOME_MCP_BRIDGE

config SMART_HOME_MCP_BRIDGE_CONFIG_PATH
    string "MCP bridge server config JSON path"
    default "/data/smart_home/mcp_bridge.json"
    help
      Version 1 JSON describing the MCP server: scheme (http/https), host,
      port, path, server_id, optional authorization, headers (values may be
      ${VAR} placeholders resolved from secrets) and the tool allowlist.
      The bridge is disabled when this file is absent, malformed, or its
      allowlist is empty.

config SMART_HOME_MCP_BRIDGE_SECRETS_PATH
    string "MCP bridge secrets JSON path"
    default "/data/smart_home/secrets.json"
    help
      Version 1 secrets JSON containing mcp_bridge.header_values used to
      resolve ${VAR} placeholders in the server config. The bridge is
      disabled when the config file is absent, malformed, or its allowlist
      is empty.

config SMART_HOME_MCP_BRIDGE_HTTP_HEADER_SIZE
    int "MCP HTTP response header buffer size"
    default 2048
    range 512 4096
    help
      Bounded HTTP/1.1 header buffer for the direct plain-TCP MVP client.
      Servers with larger headers are rejected instead of consuming memory.

config SMART_HOME_MCP_BRIDGE_DISCOVERY_STACKSIZE
    int "MCP manual operation worker stack size"
    default 16384
    range 8192 65536
    help
      Stack for the worker that performs a manually requested TLS handshake
      and initialize/tools/list exchange. The worker starts idle, so MCP
      network I/O never delays the LVGL first screen. mbedTLS plus bounded
      response parsing does not fit the default pthread stack. Use 65536
      while diagnosing TLS stack usage on memory-rich targets.

config SMART_HOME_MCP_BRIDGE_REQUEST_TIMEOUT_MS
    int "MCP discovery request deadline in ms"
    default 30000
    range 1000 120000
    help
      Total deadline for the direct MCP initialize, initialized notification,
      and tools/list exchange. This is one shared deadline for a discovery
      operation, rather than a per-request timeout.

endif

config SMART_HOME_DEMO_DATA_ROOT
    string "Smart home demo data root"
    default "/data"
    help
      Root directory used by the LVGL UI to load resources.
      Fonts:      <root>/res/fonts/MiSans-Normal.ttf
      Icons:      <root>/res/icons/*.png  (25 PNG files from res/icons/)
      The icon search path is <root>/res/icons.

choice SMART_HOME_DEMO_UI_BACKEND
    prompt "Smart home UI backend"
    default SMART_HOME_DEMO_UI_CONSOLE
    help
      Select the user interface backend. Console is the current runnable
      backend. LVGL is the product UI direction and uses an async worker to
      call the shared smart_home agent app API.

config SMART_HOME_DEMO_UI_CONSOLE
    bool "Console UI"

config SMART_HOME_DEMO_UI_LVGL
    bool "LVGL UI"
    depends on GRAPHICS_LVGL
    help
      Build the LVGL UI for panel/chat/settings screens. PNG decoders are
      optional: the UI uses compiled icon fonts when external icon resources
      are unavailable. Chat requests are sent to cAGENT from a worker thread
      and results are posted back to the LVGL thread with lv_async_call().

config SMART_HOME_DEMO_UI_QUICKAPP
    bool "QuickApp UI"
    depends on QUICKAPP && QUICKAPP_VAPP && FEATURE_FRAMEWORK
    select FEATURE_SYSTEM_SMARTHOME
    help
      Build SmartHome as the native state and IPC service for a separately
      launched QuickApp RPK. This mode does not compile or start the native
      LVGL product UI; LVGL remains enabled as a QuickApp runtime dependency.
      The smart_home process remains running to serve system.smarthome IPC
      requests from the VAPP process.

endchoice

if SMART_HOME_DEMO_UI_LVGL

config SMART_HOME_V9_PERF_LOG
    bool "Log V9 LVGL frame timing"
    default n
    help
      Log accumulated lv_timer_handler duration, average and maximum every
      five seconds.  Intended for target-board P01-P12 measurements; leave
      disabled in production because serial output itself costs CPU time.

config SMART_HOME_V9_DEVICE_ANIMATION
    bool "Enable V9 device pixel-frame animation"
    default n
    help
      V9 device cards use static on/off art by default.  Pixel-frame
      animation is opt-in until the target PSRAM/Flash/stack budget and
      frame-cache policy have been measured.  Disabling it is the
      documented static fallback, not a claim that animation is ready.

config SMART_HOME_CAMERA_PREVIEW
    bool "Enable local SC2336 device preview"
    depends on ARCH_BOARD_ESP32P4_FUNCTION_EV_BOARD
    depends on ESP32P4_FUNCTION_EV_BOARD_CAMERA_SC2336_VIDEO
    default n
    help
      Enable the Smart Home-owned /dev/video0 consumer. The camera service
      captures the SC2336 RGB565 stream in a worker and publishes a copied
      512x300 preview to the LVGL device popup at a maximum of 15 FPS.
      It is intentionally independent of cAGENT and network services.

config SMART_HOME_CAMERA_PPA
    bool "Scale camera previews with ESP32-P4 PPA"
    depends on SMART_HOME_CAMERA_PREVIEW && ESP32P4_PPA
    default n
    help
      Scale RGB565 frames from 1024x600 to 512x300 using PPA on CPU0.
      Keep capture buffers until DMA completes; use CPU scaling if PPA
      initialization or a job fails after safe buffer ownership recovery.
      Print hardware/CPU frame counts and scaling times for board checks.

config SMART_HOME_CAMERA_TOOL
    bool "Agent camera tool (power + snapshot)"
    depends on SMART_HOME_CAMERA_PREVIEW
    default n
    help
      Register a local agent tool `camera` with status/on/off/shot
      actions.  `shot` captures the latest 512x300 preview, computes
      brightness and frame-to-frame motion, and stores two rolling
      files under /data/smart_home/snapshots (about 600 KB total).
      Runs only through the camera service; it never opens /dev/video0.
      Needs about 600 KB of free space on /data for the two slots.

config SMART_HOME_MILOCO_BRIDGE
    bool "Enable Xiaomi Miloco gateway bridge"
    depends on SMART_HOME_DEMO_UI_LVGL
    default n
    help
      Bridge remote Mi Home devices through a Xiaomi Miloco backend that
      runs on a home server. Devices are polled over plain LAN HTTP
      (default port 1810) and displayed as remote cards on the device
      panel; power control is issued via the /miot REST API from a
      dedicated worker thread. Gateway host/port/token are stored in
      secrets.json and configured from the settings page.

config SMART_HOME_ONBOARDING
    bool "First-run configuration guide"
    depends on SMART_HOME_DEMO_UI_LVGL
    default y
    help
      Show a setup overlay on the home screen while the Wi-Fi link, the
      Miloco gateway or the model service is still unconfigured. The
      overlay lists the three items side by side, jumps to the matching
      settings page, and can always be dismissed with "later".

      It covers the home screen but does not block it: the home page is
      fully built first, so dismissing the overlay immediately shows the
      demo content. The dismissal is memory-only for this boot, because
      writing LittleFS from the LVGL thread hard-freezes the system.

      Say N to build without the overlay, for example for a demo image
      that must boot straight into the product screens.

config SMART_HOME_MILOCO_VOLATILE_CONFIG
    bool "Miloco gateway config is memory-only (skip secrets.json write)"
    depends on SMART_HOME_MILOCO_BRIDGE
    default n
    help
      Workaround while a smart_home-runtime flash write hard-freezes the
      system (MSPI arbitration during LittleFS erase).  The gateway
      configuration is applied to the worker directly and lost on reboot;
      the bind page reads the running config from the service instead of
      secrets.json.  Re-enable persistence once the flash-write freeze is
      root-caused.

config SMART_HOME_DEMO_STATIC_LVGL_HOME
    bool "P4X static LVGL home screen"
    depends on ARCH_BOARD_ESP32P4_FUNCTION_EV_BOARD
    default n
    help
      Build only the local, static Smart Home home screen for the
      ESP32-P4X-Function-EV-Board. This P2 bring-up profile uses /dev/fb0
      and LVGL but intentionally does not initialize cAGENT, networking,
      model credentials, MCP, Node gateway, mobile App bridge, or touch
      input. It keeps the first visual integration test isolated from all
      cloud and peripheral dependencies.

config SMART_HOME_DEMO_LVGL_FB_PATH
    string "LVGL framebuffer device path"
    default "/dev/lcd0" if LV_USE_NUTTX_LCD
    default "/dev/fb0"
    help
      Framebuffer or LCD device opened by the LVGL NuttX port. The P4X
      framebuffer profile uses /dev/fb0; existing LCD-based targets retain
      /dev/lcd0 when LV_USE_NUTTX_LCD is enabled.

config SMART_HOME_DEMO_UI_LVGL_ICONS
    string "LVGL UI icons directory"
    default "/data/res/icons"
    help
      Filesystem path where PNG icons are installed. The 25 icon files
      from res/icons/ should be copied to this directory via ROMFS mount
      or data partition pre-population.

endif

config SMART_HOME_WIFI_SSID
    string "Default WiFi SSID"
    default "123"
    depends on SMART_HOME_DEMO
    help
        Compile-time default WiFi SSID. Used when /data/wapi.conf does not
        exist or cannot be parsed. Users can override at runtime by writing
        a JSON config to /data/wapi.conf (see docs/esp32s3-box.md).

config SMART_HOME_WIFI_PASSWORD
    string "Default WiFi password"
    default "88888888"
    depends on SMART_HOME_DEMO
    help
        Compile-time default WPA2 password. Used when /data/wapi.conf does
        not exist or cannot be parsed.

config SMART_HOME_WIFI_RETRY_COUNT
    int "WiFi connection retry count"
    default 3
    range 1 10
    depends on SMART_HOME_DEMO
    help
        Number of times to retry WiFi connection before giving up.

endif
```
